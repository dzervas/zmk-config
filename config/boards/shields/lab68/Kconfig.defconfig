## config/boards/shields/lab68/Kconfig.defconfig
```kconfig
# Copyright (c) 2020 The ZMK Contributors
# SPDX-License-Identifier: MIT

if SHIELD_LAB68
	# General
	config BOARD
		default "lab68"

	config ZMK_KEYBOARD_NAME
		default "Lab68"

	config ZMK_KSCAN_MATRIX_POLLING
		default y

	# config ZMK_KSCAN_COMPOSITE_DRIVER
	# 	default y

	config ZMK_BATTERY_VOLTAGE_DIVIDER
		default y

	# MCP23017 I/O Expander
	config I2C
		default y

	config GPIO_MCP230XX
		default y

	# Rotary encoder
	config EC11
		default y

	# USB stuff
	config ZMK_USB
		default y

	if USB_DEVICE_STACK
		config USB_NRFX
			default y
	endif # USB

	# Display stuff
	if ZMK_DISPLAY
		config I2C
			default y

		config SSD1306
			default y

		config SSD1306_REVERSE_MODE
			default y
	endif # display

	if LVGL
		#config LVGL_HOR_RES_MAX
		#	default 128

		#config LVGL_VER_RES_MAX
		#	default 32


		config LV_Z_VDB_SIZE
			default 64

		config LV_Z_DPI
			default 148

		config LV_Z_BITS_PER_PIXEL
			default 1

		choice LV_COLOR_DEPTH
			default LV_COLOR_DEPTH_1
		endchoice
	endif # LVGL

	# Bluetooth settings
	config ZMK_BLE
		default y

	config BT_CTLR
		default BT

	config BT_BONDING_REQUIRED
		default y

	config BT_SMP_SC_ONLY
		default y

	config BT_SETTINGS_CCC_STORE_ON_WRITE
		default y

	# Low-level hardware
	config HW_STACK_PROTECTION
		default y

	config MPU_ALLOW_FLASH_WRITE
		default y

	config NVS
		default y

	config FLASH
		default y

	config FLASH_MAP
		default y

	config USB_CDC_ACM_RINGBUF_SIZE
		default 4096

	config PINCTRL
		default y

	# MCUBoot
	config BOOTLOADER_MCUBOOT
		default y

	config ROM_START_OFFSET
		default 0x200

endif
```

## config/boards/shields/lab68/Kconfig.shield
```kconfig
# Copyright (c) 2020 The ZMK Contributors
# SPDX-License-Identifier: MIT

config SHIELD_LAB68
	def_bool $(shields_list_contains,lab68)
	# depends on BOARD_PARTICLE_XENON
```

## config/boards/shields/lab68/lab68_defconfig
```kconfig
CONFIG_MPU_ALLOW_FLASH_WRITE=y
# CONFIG_NVS=y
# CONFIG_SETTINGS_NVS=y
CONFIG_FLASH=y
CONFIG_FLASH_PAGE_LAYOUT=y
CONFIG_FLASH_MAP=y

CONFIG_HW_STACK_PROTECTION=y
```

## config/boards/shields/lab68/lab68_mcuboot_defconfig
```kconfig
# The UART is used for Serial Recovery, so logging requires
# an RTT console, which is not available out of the box on this board.
CONFIG_LOG=n

CONFIG_FLASH=y
CONFIG_FLASH_PAGE_LAYOUT=y
CONFIG_FLASH_MAP=y

# The build won't fit on the partition allocated for it without size
# optimizations.
CONFIG_SIZE_OPTIMIZATIONS=y

# Serial
CONFIG_SERIAL=y
CONFIG_UART_NRFX=y
CONFIG_UART_INTERRUPT_DRIVEN=y
CONFIG_UART_LINE_CTRL=y

# MCUBoot serial
CONFIG_GPIO=y
CONFIG_MCUBOOT_SERIAL=y
CONFIG_MCUBOOT_INDICATION_LED=y
CONFIG_BOOT_SERIAL_CDC_ACM=y
CONFIG_BOOT_SERIAL_NO_APPLICATION=y
CONFIG_BOOT_SERIAL_PIN_RESET=y

# Required by USB
CONFIG_MULTITHREADING=y

# USB
CONFIG_USB_DEVICE_STACK=y
CONFIG_USB_DEVICE_PRODUCT="Lab68 MCUBoot"
CONFIG_USB_DEVICE_PID=0x0135
CONFIG_USB_DEVICE_VID=0x1FC9

CONFIG_USB_COMPOSITE_DEVICE=n
CONFIG_USB_MASS_STORAGE=n

# Signing
CONFIG_BOOT_SIGNATURE_TYPE_RSA=n
CONFIG_BOOT_SIGNATURE_TYPE_ED25519=y
CONFIG_BOOT_SIGNATURE_KEY_FILE="signing-key-ed25519.pem"

CONFIG_BOOT_VALIDATE_SLOT0=y

CONFIG_USE_DT_CODE_PARTITION=y
```

## config/boards/shields/launchpad/Kconfig.defconfig
```kconfig
# Copyright (c) 2020 The ZMK Contributors
# SPDX-License-Identifier: MIT

if SHIELD_LAUNCHPAD

config BOARD
	default "particle_xenon"

config ZMK_KEYBOARD_NAME
	default "LaunchPad"

if USB

config USB_NRFX
	default y

config USB_DEVICE_STACK
	default y

endif # USB


config ZMK_BLE
	default y

config ZMK_USB
	default y

config ZMK_KSCAN_MATRIX_POLLING
	default y

config ZMK_KSCAN_COMPOSITE_DRIVER
	default y

config ZMK_BATTERY_VOLTAGE_DIVIDER
	default y

# Bluetooth settings
config BT_CTLR
	default BT

config BT_BONDING_REQUIRED
	default y

config BT_SMP_SC_ONLY
	default y

config BT_SETTINGS_CCC_STORE_ON_WRITE
	default y

# Hardware stuff
config HW_STACK_PROTECTION
	default y

config MPU_ALLOW_FLASH_WRITE
	default y

config NVS
	default y

config FLASH
	default y

config FLASH_MAP
	default y

# MCUBoot
config BOOTLOADER_MCUBOOT
	default y

config ROM_START_OFFSET
	default 0x200

endif
```

## config/boards/shields/launchpad/launchpad_mcuboot_defconfig
```kconfig
# The UART is used for Serial Recovery, so logging requires
# an RTT console, which is not available out of the box on this board.
CONFIG_LOG=n
# CONFIG_DEBUG=n

CONFIG_FLASH=y
CONFIG_FLASH_PAGE_LAYOUT=y
CONFIG_FLASH_MAP=y
# CONFIG_BOOTLOADER_MCUBOOT=y

CONFIG_BOOTLOADER_MCUBOOT=y

# Ensure that the qspi driver is disabled by default
# CONFIG_NORDIC_QSPI_NOR=n

# The build won't fit on the partition allocated for it without size
# optimizations.
CONFIG_SIZE_OPTIMIZATIONS=y


# Serial
CONFIG_SERIAL=y
CONFIG_UART_NRFX=y
CONFIG_UART_INTERRUPT_DRIVEN=y
CONFIG_UART_LINE_CTRL=y

# MCUBoot serial
CONFIG_CONSOLE=n
CONFIG_UART_CONSOLE=n
CONFIG_GPIO=y
CONFIG_MCUBOOT_SERIAL=y
CONFIG_BOOT_SERIAL_UART=y
# CONFIG_BOOT_SERIAL_DETECT_PIN=11
# CONFIG_BOOT_SERIAL_DETECT_DELAY=450
# CONFIG_BOOT_SERIAL_CDC_ACM=y

# Required by USB
CONFIG_MULTITHREADING=y

# USB
CONFIG_USB_DEVICE_STACK=y
CONFIG_USB_DEVICE_REMOTE_WAKEUP=n
CONFIG_USB_DEVICE_PRODUCT="LaunchPad MCUBoot"
CONFIG_USB_DEVICE_PID=0x0135
CONFIG_USB_DEVICE_VID=0x1FC9

# CONFIG_USB_COMPOSITE_DEVICE=n
# CONFIG_USB_MASS_STORAGE=n

# CONFIG_NORDIC_QSPI_NOR=n

# Signing
# CONFIG_BOOT_SIGNATURE_TYPE_RSA=n
# CONFIG_BOOT_SIGNATURE_TYPE_ED25519=y
# CONFIG_BOOT_SIGNATURE_KEY_FILE="signing-key-ed25519.pem"
# CONFIG_MCUBOOT_SIGNATURE_KEY_FILE="mcuboot/signing-key-ed25519.pem"
# CONFIG_MCUBOOT_VALIDATE_PRIMARY_SLOT=y
# CONFIG_BOOT_VALIDATE_SLOT0=y

CONFIG_USE_DT_CODE_PARTITION=y
```

## config/west.yml
```yaml
manifest:
  remotes:
    - name: dzervas
      url-base: https://github.com/dzervas
    - name: runtimeco
      url-base: https://github.com/runtimeco
    - name: zephyr
      url-base: https://github.com/zephyrproject-rtos
    - name: zmkfirmware
      url-base: https://github.com/zmkfirmware
  projects:
    - name: zmk
      remote: zmkfirmware
      revision: v0.3
      import: app/west.yml
    - name: mcuboot
      remote: zephyr
      # Taken from zephyr/west.yml that ZMK uses - should be on par with it
      revision: 13f63976bca672ee018f9d55f1e31f02f4135b64
  self:
    path: config
```
